/*
 * wiring_tone.c - tone() / noTone() for the dsPIC33CK Arduino core
 *
 * A square wave on ANY digital pin, generated by toggling the pin's LATx bit
 * from a timer ISR.
 *
 * WHY AN ISR AND NOT HARDWARE PWM
 * The obvious implementation is SCCP4 in PWM mode with its output routed to the
 * pin through PPS, which would cost zero CPU and hit the frequency exactly. It
 * only works for pins that HAVE a PPS number, though: PORTA has no RPn at all
 * on any device in this family, and neither does PORTE on the MP508. That would
 * make tone() work on some pins and silently do nothing on others -- including
 * LED_BUILTIN on two of the four boards. Toggling from an ISR works everywhere,
 * so that is the baseline. The hardware path is a worthwhile follow-up for
 * remappable pins (pinToRP() is already in place for it), which is why start and
 * stop are behind _tone_start_hw()/_tone_stop_hw() rather than open-coded in
 * tone() -- a second implementation slots in behind those two names without
 * reshaping the file.
 *
 * WHICH TIMER
 * SCCP4, and it is not a free choice. See the SCCP4 POLICY comment in
 * wiring_private.h: this family has exactly one timer of its own (Timer1, which
 * millis() owns), so tone() has to take an SCCP, and every SCCP is also an
 * analogWrite() channel. A tone and analogWrite(8, ...) are therefore mutually
 * exclusive -- the same caveat stock AVR Arduino carries for pins 3 and 11.
 *
 * KNOWN RESIDUAL RACE, documented rather than fixed: the ISR's
 * "*_tone_lat ^= _tone_mask" and digitalWrite()'s LATx update are both
 * read-modify-write, so a tone ISR landing inside digitalWrite() on any pin of
 * the SAME PORT drops one half-cycle. That is one period of jitter, inaudible on
 * a piezo. Closing it would mean a DISI pair inside digitalWrite(), on the hot
 * path of the single most-called function in the core, to fix something nobody
 * can hear.
 */

#include "Arduino.h"
#include "wiring_private.h"

#ifdef __cplusplus
extern "C" {
#endif

/*
 * Where the ISR toggles, resolved once in tone().
 *
 * The ISR must not call digitalWrite(): that bounds-checks the pin and then does
 * three loads out of the const g_pin_map table, which lives in program space. At
 * 20 kHz this ISR runs 40,000 times a second, so its body is one
 * read-modify-write of a LATx register and nothing else.
 *
 * _tone_lat starts pointing at a real register with a zero mask rather than at
 * NULL: a NULL dereference here would be a write to data address 0x0000, which
 * on this architecture is W0. A stray ISR entry that cannot happen is not worth
 * a branch in the hot path, but it is worth not aiming it at the register file.
 */
static volatile uint16_t *_tone_lat  = &LATA;
static uint16_t           _tone_mask = 0;
static uint8_t            _tone_pin  = 0xFF;      /* 0xFF = nothing playing */

/* Half-cycles left to emit; 0 means "play until noTone()". Counting down in the
 * ISR is what makes the duration argument work without a second timer. */
static volatile unsigned long _tone_toggles = 0;

static void _tone_stop_hw(void)
{
    /* IE first, then CCPON, then the flag. After the IEC write no new ISR entry
     * is possible, and an ISR already in flight runs at IPL5 so it has finished
     * before this function's first instruction. That ordering is what lets
     * _tone_release() clear the LAT bit afterwards without racing the toggle. */
    IEC2bits.CCT4IE = 0;
    CCP4CON1L = 0;                  /* CCPON = 0, and reset the prescaler field */
    IFS2bits.CCT4IF = 0;
}

/*
 * Period-match ISR.
 *
 * The vector is _CCT4Interrupt, NOT _CCP4Interrupt. CCTxIF is the SCCP's
 * time-base period match; CCPxIF is the capture/compare event, which in Dual
 * Timer mode comes from the secondary period register CCP4PRH. Getting this
 * wrong links cleanly and then never fires.
 *
 * no_auto_psv deviates from the auto_psv this core uses on _T1Interrupt and
 * _U1RXInterrupt. It is correct here precisely because the body reads no
 * program-space data -- no const tables, no function pointers -- so saving,
 * setting and restoring PSVPAG would be pure overhead on the hottest ISR in the
 * core.
 */
void __attribute__((interrupt, no_auto_psv)) _CCT4Interrupt(void)
{
    IFS2bits.CCT4IF = 0;

    *_tone_lat ^= _tone_mask;

    if (_tone_toggles != 0UL && --_tone_toggles == 0UL) {
        _tone_stop_hw();
        /* Park the pin LOW rather than wherever the last toggle left it: a piezo
         * held HIGH sits with DC across it and keeps drawing current. */
        *_tone_lat &= (uint16_t)~_tone_mask;
    }
}

/*
 * Pick the smallest prescaler whose 16-bit period register can still express
 * this frequency, and return the period along with the TMRPS code.
 *
 * analogWrite() gets to fix its prescaler at compile time (PWM_PRESCALER,
 * wiring_analog.c) because it is always ~490 Hz. tone() cannot: at FCY = 100 MHz
 * a 1:1 prescaler bottoms out at 100e6/(2*65536) = 763 Hz, which is in the
 * middle of the musical range, while at FCY = 4 MHz a fixed 1:64 would throw
 * away most of the resolution above 1 kHz.
 *
 * Out-of-range frequencies clamp rather than no-op -- a sketch asking for 5 Hz
 * on a 100 MHz part gets the lowest note the clock can produce, which is easier
 * to diagnose on a bench than silence.
 */
static uint8_t _tone_timing(unsigned int frequency, uint16_t *period_out)
{
    static const unsigned long ps_val[4] = { 1UL, 4UL, 16UL, 64UL };
    unsigned long ticks = 0UL;
    uint8_t code;

    for (code = 0U; code < 4U; code++) {
        /* Redo the whole divide for each candidate instead of shifting the
         * previous result: shifting compounds the truncation error, and at the
         * top of the range the error is a large fraction of the period. */
        ticks = FCY / (ps_val[code] * 2UL * (unsigned long)frequency);
        if (ticks <= 65536UL) break;
    }

    if (code >= 4U) {
        code  = 3U;
        ticks = 65536UL;        /* below the lowest note this clock can reach */
    } else if (ticks < 2UL) {
        ticks = 2UL;            /* above the highest */
    }

    *period_out = (uint16_t)(ticks - 1UL);
    return code;
}

/*
 * Half-cycles for "duration" ms at "frequency" Hz:
 *
 *     toggles = 2 * frequency * duration / 1000  ==  duration * frequency / 500
 *
 * computed the long way because the obvious expression wraps a 32-bit unsigned
 * as soon as duration * frequency exceeds 4.29e9 -- about ten minutes at
 * 20 kHz -- and a wrap does not degrade gracefully, it turns a long tone into a
 * short blip.
 *
 * Splitting duration into whole 500 ms units plus a remainder keeps both
 * products small: rem is under 500, so rem * frequency tops out around 3.3e7.
 * That avoids uint64_t, which would drag __udivdi3 into every sketch on a 32 KB
 * MP102.
 *
 * Returns 0 for "play forever", which is both the duration == 0 contract and the
 * fallback when even the split arithmetic cannot hold the count.
 */
static unsigned long _tone_count(unsigned int frequency, unsigned long duration)
{
    unsigned long whole, rem, toggles;

    if (duration == 0UL) return 0UL;

    whole = duration / 500UL;
    rem   = duration % 500UL;

    if (whole >= (0xFFFFFFFFUL / (unsigned long)frequency)) {
        return 0UL;             /* longer than we can count; treat as continuous */
    }

    toggles  = whole * (unsigned long)frequency;
    toggles += (rem * (unsigned long)frequency) / 500UL;

    /* A duration too short for even one half-cycle must produce a click, not
     * "forever" -- 0 is the sentinel. */
    if (toggles == 0UL) toggles = 1UL;

    return toggles;
}

static void _tone_start_hw(uint8_t ps_code, uint16_t period)
{
    /* Whole-word writes rather than the bitfield style used in analogWrite():
     * we may be reconfiguring a module that was running a moment ago, and a
     * read-modify-write per field leaves it in intermediate states.
     *
     * CCP4CON2H = 0 keeps OCAEN clear, so the module drives no pin at all --
     * the output is entirely the ISR's LATx toggle.
     * CCP4CON1H = 0 gives OPS = 0000, "interrupt after each time base period
     * match", with no trigger and no one-shot. */
    CCP4CON1H = 0;
    CCP4CON2L = 0;
    CCP4CON2H = 0;
    CCP4CON3H = 0;
    CCP4TMRL  = 0;
    CCP4TMRH  = 0;
    CCP4PRL   = period;
    CCP4PRH   = 0xFFFF;         /* unused secondary timer; park it out of the way */

    IPC10bits.CCT4IP = 5;
    IFS2bits.CCT4IF  = 0;
    IEC2bits.CCT4IE  = 1;

    /* CCPON last, in the same word as the prescaler. MOD = 0000 with CCSEL = 0
     * selects General Purpose Timer mode; T32 = 0 selects the 16-bit primary
     * time base (CCP4TMRL against CCP4PRL); CLKSEL = 000 selects FOSC/2 = FCY;
     * TMRPS sits at bits 7:6. */
    CCP4CON1L = (uint16_t)0x8000U | (uint16_t)((uint16_t)ps_code << 6);
}

void tone(uint8_t pin, unsigned int frequency, unsigned long duration)
{
    const pin_map_t *p;
    uint16_t period;
    uint16_t mask;
    uint8_t  ps_code;
    unsigned long toggles;

    if (pin >= NUM_DIGITAL_PINS) return;
    if (frequency == 0U) { noTone(pin); return; }

    /* Before any CCP4 register write, or they go nowhere. */
    _sccp_pmd_enable();

    /* Clear SCCP4 of whatever is on it: an older tone, or PWM on D8. Both would
     * otherwise fight the configuration below, and in the PWM case the pad would
     * stay connected to the module through PPS. */
    _tone_stop_hw();
    _pwm_disable_pin(PWM4_PIN);

    p    = &g_pin_map[pin];
    mask = (uint16_t)(1U << p->bit);

    /* Drive the pin, LOW to start. Done inline rather than through
     * pinMode()/digitalWrite() so the analog mux is cleared in the same breath
     * and the pin is already low before the first toggle. */
    if (p->ansel_reg != NULL) {
        *(p->ansel_reg) &= (uint16_t)~mask;
    }
    *(p->lat_reg)  &= (uint16_t)~mask;
    *(p->tris_reg) &= (uint16_t)~mask;

    ps_code = _tone_timing(frequency, &period);
    toggles = _tone_count(frequency, duration);

    /* Publish the ISR's view of the world while the vector is still disabled. */
    _tone_lat     = p->lat_reg;
    _tone_mask    = mask;
    _tone_pin     = pin;
    _tone_toggles = toggles;

    _tone_start_hw(ps_code, period);
}

/*
 * Stop the tone and park its pin as an OUTPUT driving LOW.
 *
 * Also the cross-module entry point analogWrite() calls before it touches
 * SCCP4 -- see wiring_private.h.
 */
void _tone_release(void)
{
    if (_tone_pin == 0xFF) return;

    _tone_stop_hw();
    *_tone_lat &= (uint16_t)~_tone_mask;

    _tone_toggles = 0UL;
    _tone_mask    = 0U;
    _tone_pin     = 0xFF;
}

void noTone(uint8_t pin)
{
    /* Only if this is the pin actually playing. Upstream behaves the same way --
     * it looks up the timer behind the given pin and stops that one -- and the
     * check matters here for a specific reason: without it, noTone() on some
     * unrelated pin would tear down a PWM that analogWrite() had since set up on
     * D8. */
    if (_tone_pin == 0xFF || pin != _tone_pin) return;

    _tone_release();
}

#ifdef __cplusplus
}
#endif
